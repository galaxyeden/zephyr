## boards/milkv/duo256m/Kconfig.milkv_duo256m
```kconfig
# Copyright (c) 2024 Chen Xingyu <hi@xingrz.me>
# SPDX-License-Identifier: Apache-2.0

config BOARD_MILKV_DUO256M
	select SOC_SG2002
	select SOC_SG2002_MAIN_C906 if BOARD_MILKV_DUO256M_SG2002_MAIN_C906
	select SOC_SG2002_COPROC_C906 if BOARD_MILKV_DUO256M_SG2002_COPROC
```

## boards/milkv/duos/milkv_duos_sg2000_coproc_defconfig
```kconfig
# Copyright (c) 2024 Chen Xingyu <hi@xingrz.me>
# SPDX-License-Identifier: Apache-2.0

CONFIG_XIP=n

CONFIG_GPIO=y
CONFIG_SERIAL=y

CONFIG_CONSOLE=y
CONFIG_UART_CONSOLE=y

# Default OpenAMP for deploying from Linux
CONFIG_OPENAMP=y
CONFIG_OPENAMP_RSC_TABLE=y
CONFIG_OPENAMP_RSC_TABLE_NUM_RPMSG_BUFF=2
```

## boards/riscv/adafruit_qt_py_esp32c3/Kconfig.board
```kconfig
# Copyright (c) 2021 Pete Johanson
# SPDX-License-Identifier: Apache-2.0

config BOARD_ADAFRUIT_QT_PY_ESP32C3
	bool "Adafruit QT Py ESP32C3 Board"
	depends on SOC_ESP32C3
```

## boards/riscv/adafruit_qt_py_esp32c3/Kconfig.defconfig
```kconfig
# Copyright (c) 2021 Pete Johanson
# SPDX-License-Identifier: Apache-2.0

config BOARD
	default "adafruit_qt_py_esp32c3"
	depends on BOARD_ADAFRUIT_QT_PY_ESP32C3

if BT

config HEAP_MEM_POOL_SIZE
	default 16384

choice BT_HCI_BUS_TYPE
	default BT_ESP32
endchoice

endif # BT
```

## samples/drivers/led/led_strip/boards/xiao_ble.conf
```kconfig
CONFIG_LED=y
CONFIG_LED_SHELL=y
CONFIG_LED_STRIP=y
CONFIG_ADC=y
CONFIG_ADC_SHELL=y
CONFIG_BT=y
CONFIG_BT_SHELL=y
CONFIG_GPIO=y
CONFIG_GPIO_SHELL=y
CONFIG_SPI=y
CONFIG_I2C=y
CONFIG_I2C_SHELL=y
CONFIG_SENSOR=y
CONFIG_SENSOR_SHELL=y
CONFIG_SERIAL=y
CONFIG_SETTINGS=y
CONFIG_SETTINGS_SHELL=y
CONFIG_CONSOLE=y
CONFIG_SHELL=y
CONFIG_INPUT=y
CONFIG_INPUT_SHELL=y
CONFIG_CBPRINTF_FP_SUPPORT=y
CONFIG_UART_CONSOLE=y
CONFIG_SHELL_TAB=y
CONFIG_SHELL_TAB_AUTOCOMPLETION=y
CONFIG_PM_DEVICE=y
CONFIG_BOOT_BANNER=y
CONFIG_BOOT_BANNER_STRING="xHain nRF52840 demo by eden ariel"
CONFIG_SHELL_PROMPT_UART="xHain > "
CONFIG_UART_INTERRUPT_DRIVEN=y
CONFIG_USB_DEVICE_STACK=y
CONFIG_UART_LINE_CTRL=y
CONFIG_SERIAL=y
```

## soc/sophgo/cv180x/Kconfig.soc
```kconfig
# Copyright (c) 2023-2024 Chen Xingyu <hi@xingrz.me>
# SPDX-License-Identifier: Apache-2.0

config SOC_SERIES_CV180X
	bool
	select SOC_FAMILY_SOPHGO

config SOC_SERIES_CV180X_C906
	bool
	select SOC_SERIES_CV180X

config SOC_SERIES_CV180X_MAIN_C906
	bool
	select SOC_SERIES_CV180X_C906

config SOC_SERIES_CV180X_COPROC_C906
	bool
	select SOC_SERIES_CV180X_C906

config SOC_SERIES
	default "cv180x" if SOC_SERIES_CV180X

config SOC_CV1800B
	bool
	select SOC_SERIES_CV180X

config SOC
	default "cv1800b" if SOC_CV1800B

config SOC_CV1800B_MAIN_C906
	bool
	select SOC_SERIES_CV180X_MAIN_C906

config SOC_CV1800B_COPROC_C906
	bool
	select SOC_SERIES_CV180X_COPROC_C906

config SOC
	default "cv1800b" if SOC_CV1800B_MAIN_C906 || SOC_CV1800B_COPROC_C906
```

## soc/sophgo/cv181x/Kconfig.soc
```kconfig
# Copyright (c) 2024 Chen Xingyu <hi@xingrz.me>
# SPDX-License-Identifier: Apache-2.0

config SOC_SERIES_CV181X
	bool
	select SOC_FAMILY_SOPHGO

config SOC_SERIES_CV181X_C906
	bool
	select SOC_SERIES_CV181X

config SOC_SERIES_CV181X_MAIN_C906
	bool
	select SOC_SERIES_CV181X_C906
	select SOC_SERIES_CV181X_MAIN

config SOC_SERIES_CV181X_COPROC
	bool
	select SOC_SERIES_CV181X_C906

config SOC_SERIES
	default "cv181x" if SOC_SERIES_CV181X

config SOC_SG2000_MAIN_C906
	bool
	select SOC_SERIES_CV181X_MAIN_C906

config SOC_SG2000_COPROC_C906
	bool
	select SOC_SERIES_CV181X_COPROC

config SOC_SG2002_MAIN_C906
	bool
	select SOC_SERIES_CV181X_MAIN_C906

config SOC_SG2002_COPROC_C906
	bool
	select SOC_SERIES_CV181X_COPROC

config SOC
	default "sg2000" if SOC_SG2000_MAIN_C906 || SOC_SG2000_COPROC_C906
	default "sg2002" if SOC_SG2002_MAIN_C906 || SOC_SG2002_COPROC_C906
```
